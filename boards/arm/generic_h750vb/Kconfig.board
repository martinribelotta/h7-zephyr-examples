## boards/arm/generic_h750vb/Kconfig.board
```kconfig
# STM32H743ZI Nucleo board configuration

# Copyright (c) 2020 Teslabs Engineering S.L.
# SPDX-License-Identifier: Apache-2.0

config BOARD_GENERIC_H750VB
	bool "Generic H750 Development Board"
	depends on SOC_STM32H750XX
```

## boards/arm/generic_h750vb/Kconfig.defconfig
```kconfig
# STM32H743ZI Nucleo board configuration

# Copyright (c) 2020 Teslabs Engineering S.L.
# SPDX-License-Identifier: Apache-2.0

if BOARD_GENERIC_H750VB

config BOARD
	default "generic_h750vb"

if NETWORKING

config NET_L2_ETHERNET
	default y

endif # NETWORKING

endif # BOARD_GENERIC_H750VB
```

## boards/arm/h750_dragonman/Kconfig.board
```kconfig
config BOARD_H750_DRAGONMAN
	bool "H750 Dragonman Development Board"
	depends on SOC_STM32H750XX
```

## boards/arm/h750_dragonman/Kconfig.defconfig
```kconfig
# STM32H743ZI Nucleo board configuration

# Copyright (c) 2020 Teslabs Engineering S.L.
# SPDX-License-Identifier: Apache-2.0

if BOARD_H750_DRAGONMAN

config BOARD
	default "h750_dragonman"

if NETWORKING

config NET_L2_ETHERNET
	default y

endif # NETWORKING

endif # BOARD_H750_DRAGONMAN
```

## boards/arm/h750_dragonman/h750_dragonman_defconfig
```kconfig
CONFIG_CLOCK_CONTROL=y
CONFIG_PINCTRL=y
CONFIG_HEAP_MEM_POOL_SIZE=65536
CONFIG_GPIO=y
CONFIG_HW_STACK_PROTECTION=y
CONFIG_SOC_SERIES_STM32H7X=y
CONFIG_SOC_STM32H750XX=y
CONFIG_ARM_MPU=y
# CONFIG_INIT_STACKS is not set
# CONFIG_THREAD_MONITOR is not set
# CONFIG_THREAD_NAME is not set
CONFIG_CONSOLE=y
CONFIG_UART_CONSOLE=y
CONFIG_FLASH=y
CONFIG_FLASH_SHELL=y
CONFIG_FLASH_SHELL_TEST_COMMANDS=y
CONFIG_GPIO_SHELL=y
CONFIG_MPSC_PBUF=y
CONFIG_REBOOT=y
CONFIG_FILE_SYSTEM=y
CONFIG_FILE_SYSTEM_SHELL=y
CONFIG_FILE_SYSTEM_SHELL_TEST_COMMANDS=y
CONFIG_FILE_SYSTEM_SHELL_BUFFER_SIZE=0x4000
CONFIG_FILE_SYSTEM_MKFS=y
#CONFIG_FILE_SYSTEM_LITTLEFS=y
CONFIG_FAT_FILESYSTEM_ELM=y
CONFIG_FS_FATFS_LFN=y
CONFIG_FS_FATFS_LFN_MODE_HEAP=y
CONFIG_FS_FATFS_REENTRANT=y
CONFIG_LOG_OUTPUT=y
CONFIG_SHELL=y
CONFIG_SHELL_MINIMAL=y
CONFIG_SHELL_CMD_BUFF_SIZE=256
CONFIG_SHELL_TAB=y
CONFIG_SHELL_TAB_AUTOCOMPLETION=y
CONFIG_SHELL_WILDCARD=y
CONFIG_SHELL_VT100_COLORS=y
CONFIG_SHELL_METAKEYS=y
CONFIG_SHELL_HELP=y
CONFIG_SHELL_HELP_ON_WRONG_ARGUMENT_COUNT=y
CONFIG_SHELL_HISTORY=y
CONFIG_SHELL_HISTORY_BUFFER=512
CONFIG_SHELL_STATS=y
CONFIG_SHELL_CMDS=y
CONFIG_SHELL_CMDS_RESIZE=y
CONFIG_KERNEL_SHELL=y
CONFIG_DEVICE_SHELL=y
CONFIG_DEVMEM_SHELL=y
CONFIG_FLASH_MAP=y
CONFIG_FLASH_MAP_SHELL=y
```
